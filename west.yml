## west.yml
```yaml
# Copyright (c) 2026 Shivam Chudasama
# SPDX-License-Identifier: Apache-2.0
#
# West manifest - Forest topology for Silicon Labs BLE projects.
#
# This is a STANDALONE manifest repo. It contains NO application
# source code - only the dependency recipe. Applications live in
# separate Git repositories and are checked out manually when needed.
#
# This manifest imports the Simplicity SDK for Zephyr (zephyr-silabs),
# which is Silicon Labs' downstream manifest. It provides:
#   - SiLabs fork of Zephyr (with extra patches for SiLabs hardware)
#   - SiLabs fork of hal_silabs (with Simplicity SDK / WiSeConnect)
#   - SiLabs fork of mbedtls (with hardware crypto acceleration)
#   - Filtered set of upstream modules (no unrelated HALs)
#
# Usage:
#   west init -l https://github.com/shivamchudasama/SiLabs_Zephyr_Workspace.git
#   west update
#   west blobs fetch
#   # First build - specify board and app
#   west build -p auto -b nrf52840dk/nrf52840 samples/basic/blinky
#   # Iterative rebuild (board is remembered)
#   west build
#   # Rebuild with a clean slate
#   west build -p always
#   # Flash after building
#   west flash
#
# Adding a new application:
#   1. Create a new Git repo for your app (CMakeLists.txt + prj.conf + src/).
#   2. Push it to your Git server.
#   3. Clone it manually into this workspace when you want to work on it.

manifest:
   version: "0.13"

   remotes:
      - name: silabs                         # Name of the remote, used in project entries below
                                             # as a variable.
        url-base: https://github.com/SiliconLabsSoftware
                                             # SiLabs Zephyr fork GitHub URL.

   projects:
    # ────────────── Silicon Labs Simplicity SDK for Zephyr ──────────────
    # This is the SiLabs manifest repo. Importing it pulls in their
    # fork of Zephyr, hal_silabs, mbedtls, and the other modules
    # needed for Silicon Labs targets — with non-SiLabs HALs
    # already filtered out.
      - name: zephyr-silabs                  # Silicon Labs' downstream manifest repo
        remote: silabs                       # Use the "silabs" remote defined above
        revision: v2025.12.1                 # Latest stable release
        import: true                         # Import its manifest (west.yml)
        path: zephyr-silabs                  # Cloned here in the workspace
                                             # (name of the folder in local machine)

   self:
      path: manifest
```
